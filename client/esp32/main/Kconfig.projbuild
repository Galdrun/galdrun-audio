## client/esp32/main/Kconfig.projbuild
```kconfig
menu "Galdrun audio client"

    comment "Wi-Fi is set on the board's own settings page (setup mode), not here."
    comment "Each board in boards/ sets these; the defaults are the ESP32-A1S's."

    config MULTIROOM_SETUP_BUTTON_GPIO
        int "Setup button GPIO, held at reset for setup mode (-1: none)"
        default 36
        help
            Active low. 36 is KEY1 on the ESP32 Audio Kit.

    menu "On-board codec (ES8388)"
        comment "Defaults are the AI-Thinker ESP32 Audio Kit v2.2 wiring."

        config MULTIROOM_CODEC_I2C_SDA
            int "I2C SDA GPIO"
            default 33
        config MULTIROOM_CODEC_I2C_SCL
            int "I2C SCL GPIO"
            default 32
        config MULTIROOM_CODEC_PA_GPIO
            int "Amplifier enable GPIO (-1: none)"
            default 21
        config MULTIROOM_CODEC_I2S_MCLK
            int "I2S MCLK GPIO (ESP32: 0, 1 or 3 only; ESP32-S3: any)"
            default 0
        config MULTIROOM_CODEC_I2S_BCLK
            int "I2S BCLK GPIO"
            default 27
        config MULTIROOM_CODEC_I2S_WS
            int "I2S WS (LRCK) GPIO"
            default 25
        config MULTIROOM_CODEC_I2S_DOUT
            int "I2S data out GPIO"
            default 26
        config MULTIROOM_CODEC_DOUBLE_SPEED
            bool "Offer 88.2 and 96 kHz (double speed, MCLK 128 fs)"
            default y
            help
                As I2S master only. The codec runs double speed above 48 kHz
                with MCLK at 128 fs, the same 11.29 / 12.29 MHz as 44.1 and
                48 kHz. Off: 8 to 48 kHz single speed, as before.
    endmenu

    menu "External I2S DAC"
        comment "Device id \"i2s\". Set these to your wiring; in slave mode BCLK and WS are inputs."

        config MULTIROOM_EXT_I2S_MCLK
            int "I2S MCLK GPIO (-1: none; ESP32: 0, 1 or 3 only; ESP32-S3: any)"
            default -1
        config MULTIROOM_EXT_I2S_BCLK
            int "I2S BCLK GPIO"
            default 5
        config MULTIROOM_EXT_I2S_WS
            int "I2S WS (LRCK) GPIO"
            default 18
        config MULTIROOM_EXT_I2S_DOUT
            int "I2S data out GPIO"
            default 23
    endmenu

endmenu
```

## hardware/buildroot/board/connector2/installer/defconfig
```kconfig
# The USB installer: the board kernel with a small BusyBox/mtd-utils initramfs
# built in. The vendor U-Boot boots it from the first 0x800000 bytes of
# connect2.img without an initrd; scripts/build-usb-installer.py builds it.
BR2_arm=y
BR2_cortex_a8=y
BR2_ARM_FPU_NEON=y
BR2_TOOLCHAIN_EXTERNAL=y
BR2_TOOLCHAIN_EXTERNAL_BOOTLIN=y
BR2_TOOLCHAIN_EXTERNAL_BOOTLIN_ARMV7_EABIHF_GLIBC_STABLE=y
BR2_INIT_NONE=y
BR2_GLOBAL_PATCH_DIR="$(BR2_EXTERNAL_RAUMFELD_PATH)/board/common/patches $(BR2_EXTERNAL_RAUMFELD_PATH)/board/connector2/patches"
BR2_ROOTFS_POST_BUILD_SCRIPT="$(BR2_EXTERNAL_RAUMFELD_PATH)/board/connector2/installer/post-build.sh"
BR2_LINUX_KERNEL=y
BR2_LINUX_KERNEL_CUSTOM_VERSION=y
BR2_LINUX_KERNEL_CUSTOM_VERSION_VALUE="6.12.112"
BR2_LINUX_KERNEL_USE_CUSTOM_CONFIG=y
BR2_LINUX_KERNEL_CUSTOM_CONFIG_FILE="$(BR2_EXTERNAL_RAUMFELD_PATH)/board/connector2/linux.config"
BR2_LINUX_KERNEL_CONFIG_FRAGMENT_FILES="$(BR2_EXTERNAL_RAUMFELD_PATH)/board/connector2/installer/linux.fragment"
BR2_LINUX_KERNEL_UIMAGE=y
BR2_LINUX_KERNEL_UIMAGE_LOADADDR="0x80008000"
BR2_LINUX_KERNEL_XZ=y
BR2_LINUX_KERNEL_DTS_SUPPORT=y
BR2_LINUX_KERNEL_CUSTOM_DTS_DIR="$(BR2_EXTERNAL_RAUMFELD_PATH)/board/connector2/dts"
BR2_LINUX_KERNEL_INTREE_DTS_NAME="ti/omap/am335x-raumfeld-connector2"
BR2_PACKAGE_MTD=y
BR2_PACKAGE_MTD_FLASH_ERASE=y
BR2_PACKAGE_MTD_NANDDUMP=y
BR2_PACKAGE_MTD_NANDWRITE=y
BR2_PACKAGE_MTD_UBI_UTILS=y
# BR2_PACKAGE_MTD_JFFS_UTILS is not set
# BR2_PACKAGE_MTD_MKFSJFFS2 is not set
# BR2_PACKAGE_MTD_MKFSUBIFS is not set
# BR2_PACKAGE_MTD_SUMTOOL is not set
BR2_TARGET_ROOTFS_CPIO=y
BR2_TARGET_ROOTFS_INITRAMFS=y
# BR2_TARGET_ROOTFS_TAR is not set
```

## hardware/buildroot/board/connector3/installer/defconfig
```kconfig
# Small key-only SSH/mtd-utils userspace. Kernel and FIT are assembled separately.
BR2_arm=y
BR2_cortex_a7=y
BR2_ARM_FPU_NEON_VFPV4=y
BR2_TOOLCHAIN_EXTERNAL=y
BR2_TOOLCHAIN_EXTERNAL_BOOTLIN=y
BR2_TOOLCHAIN_EXTERNAL_BOOTLIN_ARMV7_EABIHF_GLIBC_STABLE=y
BR2_INIT_NONE=y
BR2_GLOBAL_PATCH_DIR="$(BR2_EXTERNAL_RAUMFELD_PATH)/board/common/patches"
BR2_TARGET_GENERIC_HOSTNAME="connector3-installer"
BR2_ROOTFS_POST_BUILD_SCRIPT="$(BR2_EXTERNAL_RAUMFELD_PATH)/board/connector3/installer/post-build.sh"
BR2_PACKAGE_OPENSSH=y
# BR2_PACKAGE_OPENSSH_CLIENT is not set
BR2_PACKAGE_OPENSSH_SERVER=y
BR2_PACKAGE_OPENSSH_KEY_UTILS=y
BR2_PACKAGE_MTD=y
BR2_PACKAGE_MTD_FLASH_ERASE=y
BR2_PACKAGE_MTD_NANDDUMP=y
BR2_PACKAGE_MTD_NANDWRITE=y
BR2_PACKAGE_MTD_UBIFORMAT=y
BR2_PACKAGE_MTD_UBIATTACH=y
BR2_PACKAGE_MTD_UBIDETACH=y
BR2_PACKAGE_MTD_UBINFO=y
# BR2_PACKAGE_MTD_FLASHCP is not set
# BR2_PACKAGE_MTD_FLASH_LOCK is not set
# BR2_PACKAGE_MTD_FLASH_UNLOCK is not set
# BR2_PACKAGE_MTD_MTD_DEBUG is not set
# BR2_PACKAGE_MTD_NANDTEST is not set
# BR2_PACKAGE_MTD_MTDINFO is not set
# BR2_PACKAGE_MTD_UBICRC32 is not set
# BR2_PACKAGE_MTD_UBIHEALTHD is not set
# BR2_PACKAGE_MTD_UBIMKVOL is not set
# BR2_PACKAGE_MTD_UBINIZE is not set
# BR2_PACKAGE_MTD_UBIRENAME is not set
# BR2_PACKAGE_MTD_UBIRMVOL is not set
# BR2_PACKAGE_MTD_UBIRSVOL is not set
# BR2_PACKAGE_MTD_UBIUPDATEVOL is not set
# BR2_PACKAGE_MTD_UBIBLOCK is not set
BR2_TARGET_ROOTFS_CPIO=y
BR2_TARGET_ROOTFS_CPIO_GZIP=y
BR2_TARGET_ROOTFS_TAR=y
BR2_TARGET_ROOTFS_TAR_GZIP=y
```

## hardware/buildroot/board/connector3/ram/defconfig
```kconfig
# Development RAM filesystem, loaded with kexec from the SSH-enabled vendor OS.
BR2_arm=y
BR2_cortex_a7=y
BR2_ARM_FPU_NEON_VFPV4=y
BR2_TOOLCHAIN_EXTERNAL=y
BR2_TOOLCHAIN_EXTERNAL_BOOTLIN=y
BR2_TOOLCHAIN_EXTERNAL_BOOTLIN_ARMV7_EABIHF_GLIBC_STABLE=y
BR2_INIT_NONE=y
BR2_TARGET_GENERIC_HOSTNAME="connector3-ram"
BR2_GLOBAL_PATCH_DIR="$(BR2_EXTERNAL_RAUMFELD_PATH)/board/common/patches $(BR2_EXTERNAL_RAUMFELD_PATH)/board/connector3/diagnostic/patches $(BR2_EXTERNAL_RAUMFELD_PATH)/board/connector3/ram/patches"
BR2_ROOTFS_POST_BUILD_SCRIPT="$(BR2_EXTERNAL_RAUMFELD_PATH)/board/connector3/ram/post-build.sh"
BR2_LINUX_KERNEL=y
BR2_LINUX_KERNEL_CUSTOM_VERSION=y
BR2_LINUX_KERNEL_CUSTOM_VERSION_VALUE="6.12.112"
BR2_LINUX_KERNEL_USE_DEFCONFIG=y
BR2_LINUX_KERNEL_DEFCONFIG="imx_v6_v7"
BR2_LINUX_KERNEL_CONFIG_FRAGMENT_FILES="$(BR2_EXTERNAL_RAUMFELD_PATH)/board/connector3/ram/linux.fragment"
BR2_LINUX_KERNEL_ZIMAGE=y
BR2_LINUX_KERNEL_XZ=y
BR2_LINUX_KERNEL_DTS_SUPPORT=y
BR2_LINUX_KERNEL_CUSTOM_DTS_DIR="$(BR2_EXTERNAL_RAUMFELD_PATH)/board/connector3/ram/dts"
BR2_LINUX_KERNEL_INTREE_DTS_NAME="nxp/imx/imx7d-galdrun-connector3-ram"
BR2_PACKAGE_OPENSSH=y
# BR2_PACKAGE_OPENSSH_CLIENT is not set
BR2_PACKAGE_OPENSSH_SERVER=y
BR2_PACKAGE_OPENSSH_KEY_UTILS=y
BR2_PACKAGE_ALSA_UTILS=y
BR2_PACKAGE_ALSA_UTILS_AMIXER=y
BR2_PACKAGE_ALSA_UTILS_APLAY=y
BR2_PACKAGE_ALSA_UTILS_SPEAKER_TEST=y
BR2_PACKAGE_WPA_SUPPLICANT=y
BR2_PACKAGE_WPA_SUPPLICANT_NL80211=y
BR2_PACKAGE_WPA_SUPPLICANT_PASSPHRASE=y
BR2_PACKAGE_WPA_SUPPLICANT_DEBUG_SYSLOG=y
BR2_PACKAGE_DBUS=y
BR2_PACKAGE_IW=y
BR2_PACKAGE_IPROUTE2=y
BR2_PACKAGE_ETHTOOL=y
BR2_PACKAGE_DNSMASQ=y
BR2_PACKAGE_HOSTAPD=y
BR2_PACKAGE_HOSTAPD_DRIVER_NL80211=y
# BR2_PACKAGE_HOSTAPD_ACS is not set
BR2_PACKAGE_WIRELESS_REGDB=y
BR2_PACKAGE_LINUX_FIRMWARE=y
BR2_PACKAGE_LINUX_FIRMWARE_MWIFIEX_PCIE8897=y
BR2_PACKAGE_KEXEC=y
BR2_PACKAGE_HOST_DTC=y
BR2_TARGET_ROOTFS_CPIO=y
BR2_TARGET_ROOTFS_CPIO_GZIP=y
BR2_TARGET_ROOTFS_TAR=y
BR2_TARGET_ROOTFS_TAR_GZIP=y
```

## hardware/buildroot/configs/raumfeld_connector2_defconfig
```kconfig
BR2_arm=y
BR2_cortex_a8=y
BR2_ARM_FPU_NEON=y
BR2_TOOLCHAIN_EXTERNAL=y
BR2_TOOLCHAIN_EXTERNAL_BOOTLIN=y
BR2_TOOLCHAIN_EXTERNAL_BOOTLIN_ARMV7_EABIHF_GLIBC_STABLE=y
BR2_TARGET_GENERIC_HOSTNAME="connector2"
BR2_TARGET_GENERIC_ISSUE="Custom / Raumfeld Connector 2"
BR2_TARGET_GENERIC_GETTY_PORT="ttyS0"
BR2_SYSTEM_DHCP=""
BR2_ROOTFS_OVERLAY="$(BR2_EXTERNAL_RAUMFELD_PATH)/board/common/overlay"
BR2_GLOBAL_PATCH_DIR="$(BR2_EXTERNAL_RAUMFELD_PATH)/board/common/patches $(BR2_EXTERNAL_RAUMFELD_PATH)/board/connector2/patches"
BR2_ROOTFS_POST_BUILD_SCRIPT="$(BR2_EXTERNAL_RAUMFELD_PATH)/board/connector2/post-build.sh"
BR2_ROOTFS_POST_IMAGE_SCRIPT="$(BR2_EXTERNAL_RAUMFELD_PATH)/board/connector2/post-image.sh"
BR2_LINUX_KERNEL=y
BR2_LINUX_KERNEL_CUSTOM_VERSION=y
BR2_LINUX_KERNEL_CUSTOM_VERSION_VALUE="6.12.112"
BR2_LINUX_KERNEL_USE_CUSTOM_CONFIG=y
BR2_LINUX_KERNEL_CUSTOM_CONFIG_FILE="$(BR2_EXTERNAL_RAUMFELD_PATH)/board/connector2/linux.config"
BR2_LINUX_KERNEL_UIMAGE=y
BR2_LINUX_KERNEL_UIMAGE_LOADADDR="0x80008000"
BR2_LINUX_KERNEL_DTS_SUPPORT=y
BR2_LINUX_KERNEL_CUSTOM_DTS_DIR="$(BR2_EXTERNAL_RAUMFELD_PATH)/board/connector2/dts"
BR2_LINUX_KERNEL_INTREE_DTS_NAME="ti/omap/am335x-raumfeld-connector2"
BR2_LINUX_KERNEL_INSTALL_TARGET=y
BR2_PACKAGE_ALSA_UTILS=y
BR2_PACKAGE_ALSA_UTILS_ALSAMIXER=y
BR2_PACKAGE_ALSA_UTILS_AMIXER=y
BR2_PACKAGE_ALSA_UTILS_APLAY=y
BR2_PACKAGE_ALSA_UTILS_SPEAKER_TEST=y
BR2_PACKAGE_CHRONY=y
BR2_PACKAGE_LIBCURL=y
BR2_PACKAGE_LIBCURL_CURL=y
BR2_PACKAGE_LIBCURL_VERBOSE=y
BR2_PACKAGE_OPENSSL=y
BR2_PACKAGE_LIBCURL_OPENSSL=y
BR2_PACKAGE_CA_CERTIFICATES=y
BR2_PACKAGE_RSYNC=y
BR2_PACKAGE_STRACE=y
BR2_PACKAGE_TCPDUMP=y
BR2_PACKAGE_BUSYBOX_SHOW_OTHERS=y
BR2_PACKAGE_PROCPS_NG=y
BR2_PACKAGE_BUSYBOX_CONFIG_FRAGMENT_FILES="$(BR2_EXTERNAL_RAUMFELD_PATH)/board/connector2/busybox.config"
BR2_PACKAGE_DNSMASQ=y
BR2_PACKAGE_HOSTAPD=y
BR2_PACKAGE_HOSTAPD_DRIVER_NL80211=y
# BR2_PACKAGE_HOSTAPD_ACS is not set
BR2_PACKAGE_IW=y
BR2_PACKAGE_WPA_SUPPLICANT=y
BR2_PACKAGE_WPA_SUPPLICANT_NL80211=y
BR2_PACKAGE_WPA_SUPPLICANT_PASSPHRASE=y
BR2_PACKAGE_WPA_SUPPLICANT_DEBUG_SYSLOG=y
# BR2_PACKAGE_WPA_SUPPLICANT_DBUS is not set
BR2_PACKAGE_IPROUTE2=y
BR2_PACKAGE_ETHTOOL=y
BR2_PACKAGE_WIRELESS_REGDB=y
BR2_PACKAGE_LINUX_FIRMWARE=y
BR2_PACKAGE_LINUX_FIRMWARE_MWIFIEX_SD8787=y
BR2_PACKAGE_OPENSSH=y
# BR2_PACKAGE_OPENSSH_CLIENT is not set
BR2_PACKAGE_OPENSSH_SERVER=y
BR2_PACKAGE_OPENSSH_KEY_UTILS=y
BR2_PACKAGE_MTD=y
BR2_PACKAGE_MTD_NANDDUMP=y
BR2_PACKAGE_MTD_NANDWRITE=y
BR2_PACKAGE_MTD_UBI_UTILS=y
BR2_TARGET_ROOTFS_CPIO=y
BR2_TARGET_ROOTFS_CPIO_GZIP=y
BR2_TARGET_ROOTFS_TAR_GZIP=y
BR2_TARGET_ROOTFS_UBIFS=y
BR2_TARGET_ROOTFS_UBIFS_LEBSIZE=0x1f000
BR2_TARGET_ROOTFS_UBIFS_MINIOSIZE=0x800
BR2_TARGET_ROOTFS_UBIFS_MAXLEBCNT=1578
BR2_TARGET_ROOTFS_UBI=y
BR2_TARGET_ROOTFS_UBI_PEBSIZE=0x20000
BR2_TARGET_ROOTFS_UBI_SUBSIZE=512
BR2_TARGET_ROOTFS_UBI_USE_CUSTOM_CONFIG=y
BR2_TARGET_ROOTFS_UBI_CUSTOM_CONFIG_FILE="$(BR2_EXTERNAL_RAUMFELD_PATH)/board/connector2/ubinize.cfg"
BR2_TARGET_ROOTFS_UBI_OPTS="-O 2048"
BR2_PACKAGE_HOST_DTC=y
BR2_PACKAGE_HOST_UBOOT_TOOLS=y
BR2_PACKAGE_HOST_UTIL_LINUX=y
```

## hardware/buildroot/configs/raumfeld_rpi4_defconfig
```kconfig
BR2_aarch64=y
BR2_cortex_a72=y
BR2_TOOLCHAIN_EXTERNAL=y
BR2_TOOLCHAIN_EXTERNAL_BOOTLIN=y
BR2_TOOLCHAIN_EXTERNAL_BOOTLIN_AARCH64_GLIBC_STABLE=y
BR2_ROOTFS_DEVICE_CREATION_DYNAMIC_MDEV=y
BR2_TARGET_GENERIC_HOSTNAME="galdrun-rpi4"
BR2_TARGET_GENERIC_ISSUE="Galdrun / Raspberry Pi"
# BR2_TARGET_ENABLE_ROOT_LOGIN is not set
BR2_TARGET_GENERIC_GETTY_PORT="ttyAMA0"
BR2_SYSTEM_DHCP=""
BR2_ROOTFS_OVERLAY="$(BR2_EXTERNAL_RAUMFELD_PATH)/board/common/overlay $(BR2_EXTERNAL_RAUMFELD_PATH)/board/rpi/overlay"
BR2_GLOBAL_PATCH_DIR="$(BR2_EXTERNAL_RAUMFELD_PATH)/board/common/patches $(BR2_EXTERNAL_RAUMFELD_PATH)/board/rpi/patches"
BR2_ROOTFS_POST_BUILD_SCRIPT="$(BR2_EXTERNAL_RAUMFELD_PATH)/board/rpi/post-build.sh"
BR2_ROOTFS_POST_IMAGE_SCRIPT="$(BR2_EXTERNAL_RAUMFELD_PATH)/board/rpi/post-image.sh"
BR2_LINUX_KERNEL=y
BR2_LINUX_KERNEL_CUSTOM_TARBALL=y
BR2_LINUX_KERNEL_CUSTOM_TARBALL_LOCATION="https://github.com/raspberrypi/linux/archive/9cf0f5c001b790d53689b4aadca873db169cbc44/linux-9cf0f5c001b790d53689b4aadca873db169cbc44.tar.gz"
BR2_LINUX_KERNEL_DEFCONFIG="bcm2711"
BR2_LINUX_KERNEL_CONFIG_FRAGMENT_FILES="$(BR2_EXTERNAL_RAUMFELD_PATH)/board/rpi/linux.fragment $(BR2_EXTERNAL_RAUMFELD_PATH)/board/rpi/arm64.fragment"
BR2_LINUX_KERNEL_IMAGE=y
BR2_LINUX_KERNEL_DTS_SUPPORT=y
BR2_LINUX_KERNEL_INTREE_DTS_NAME="broadcom/bcm2711-rpi-4-b"
BR2_LINUX_KERNEL_DTB_OVERLAY_SUPPORT=y
BR2_LINUX_KERNEL_INTREE_DTSO_NAMES="overlays/vc4-kms-v3d-pi4 overlays/disable-bt overlays/hifiberry-dac overlays/hifiberry-dacplus overlays/hifiberry-dacplus-pro overlays/hifiberry-dacplus-std overlays/hifiberry-dacplushd overlays/hifiberry-dacplusadc overlays/hifiberry-dacplusadcpro overlays/hifiberry-dacplusdsp overlays/hifiberry-digi overlays/hifiberry-digi-pro overlays/hifiberry-amp overlays/hifiberry-amp100 overlays/hifiberry-amp4pro overlays/iqaudio-dac overlays/iqaudio-dacplus overlays/rpi-dacpro overlays/iqaudio-codec overlays/iqaudio-digi-wm8804-audio overlays/justboom-dac overlays/justboom-digi overlays/allo-boss-dac-pcm512x-audio overlays/allo-boss2-dac-audio overlays/allo-digione overlays/allo-piano-dac-pcm512x-audio overlays/allo-piano-dac-plus-pcm512x-audio overlays/allo-katana-dac-audio overlays/audioinjector-wm8731-audio overlays/audioinjector-isolated-soundcard overlays/fe-pi-audio overlays/i-sabre-q2m"
BR2_LINUX_KERNEL_NEEDS_HOST_OPENSSL=y
BR2_LINUX_KERNEL_INSTALL_TARGET=y
BR2_PACKAGE_RPI_FIRMWARE_CONFIG_FILE="$(BR2_EXTERNAL_RAUMFELD_PATH)/board/rpi4/config.txt"
BR2_PACKAGE_RPI_FIRMWARE_CMDLINE_FILE="$(BR2_EXTERNAL_RAUMFELD_PATH)/board/rpi4/cmdline.txt"
BR2_PACKAGE_ALSA_UTILS=y
BR2_PACKAGE_ALSA_UTILS_ALSAMIXER=y
BR2_PACKAGE_ALSA_UTILS_AMIXER=y
BR2_PACKAGE_ALSA_UTILS_APLAY=y
BR2_PACKAGE_ALSA_UTILS_SPEAKER_TEST=y
BR2_PACKAGE_CHRONY=y
BR2_PACKAGE_LIBCURL=y
BR2_PACKAGE_LIBCURL_CURL=y
BR2_PACKAGE_LIBCURL_VERBOSE=y
BR2_PACKAGE_OPENSSL=y
BR2_PACKAGE_LIBCURL_OPENSSL=y
BR2_PACKAGE_CA_CERTIFICATES=y
BR2_PACKAGE_RSYNC=y
BR2_PACKAGE_STRACE=y
BR2_PACKAGE_TCPDUMP=y
BR2_PACKAGE_BUSYBOX_SHOW_OTHERS=y
BR2_PACKAGE_PROCPS_NG=y
BR2_PACKAGE_BUSYBOX_CONFIG_FRAGMENT_FILES="$(BR2_EXTERNAL_RAUMFELD_PATH)/board/common/busybox.config"
BR2_PACKAGE_DNSMASQ=y
BR2_PACKAGE_HOSTAPD=y
BR2_PACKAGE_HOSTAPD_DRIVER_NL80211=y
# BR2_PACKAGE_HOSTAPD_ACS is not set
BR2_PACKAGE_IW=y
BR2_PACKAGE_WPA_SUPPLICANT=y
BR2_PACKAGE_WPA_SUPPLICANT_NL80211=y
BR2_PACKAGE_WPA_SUPPLICANT_PASSPHRASE=y
BR2_PACKAGE_WPA_SUPPLICANT_DEBUG_SYSLOG=y
# BR2_PACKAGE_WPA_SUPPLICANT_DBUS is not set
BR2_PACKAGE_IPROUTE2=y
BR2_PACKAGE_ETHTOOL=y
BR2_PACKAGE_WIRELESS_REGDB=y
BR2_PACKAGE_LINUX_FIRMWARE=y
BR2_PACKAGE_OPENSSH=y
# BR2_PACKAGE_OPENSSH_CLIENT is not set
BR2_PACKAGE_OPENSSH_SERVER=y
BR2_PACKAGE_OPENSSH_KEY_UTILS=y
BR2_PACKAGE_KMOD=y
BR2_PACKAGE_KMOD_TOOLS=y
BR2_PACKAGE_XZ=y
BR2_PACKAGE_HOST_KMOD_XZ=y
BR2_PACKAGE_I2C_TOOLS=y
BR2_PACKAGE_LINUX_FIRMWARE_ATHEROS_9271=y
BR2_PACKAGE_LINUX_FIRMWARE_ATHEROS_7010=y
BR2_PACKAGE_LINUX_FIRMWARE_RALINK_RT2XX=y
BR2_PACKAGE_LINUX_FIRMWARE_MEDIATEK_MT7601U=y
BR2_PACKAGE_LINUX_FIRMWARE_MEDIATEK_MT7610E=y
BR2_PACKAGE_LINUX_FIRMWARE_MEDIATEK_MT76X2E=y
BR2_PACKAGE_LINUX_FIRMWARE_RTL_81XX=y
BR2_PACKAGE_LINUX_FIRMWARE_RTL_87XX=y
BR2_PACKAGE_LINUX_FIRMWARE_RTL_88XX=y
BR2_PACKAGE_RPI_FIRMWARE=y
BR2_PACKAGE_RPI_FIRMWARE_VARIANT_PI4=y
# BR2_PACKAGE_RPI_FIRMWARE_INSTALL_DTB_OVERLAYS is not set
BR2_TARGET_ROOTFS_EXT2=y
BR2_TARGET_ROOTFS_EXT2_4=y
BR2_TARGET_ROOTFS_EXT2_SIZE="512M"
BR2_TARGET_ROOTFS_EXT2_LABEL="galdrun-root"
BR2_TARGET_ROOTFS_TAR_GZIP=y
BR2_PACKAGE_HOST_DOSFSTOOLS=y
BR2_PACKAGE_HOST_GENIMAGE=y
BR2_PACKAGE_HOST_MTOOLS=y
BR2_PACKAGE_HOST_DTC=y
BR2_PACKAGE_BRCMFMAC_SDIO_FIRMWARE_RPI=y
BR2_PACKAGE_BRCMFMAC_SDIO_FIRMWARE_RPI_WIFI=y
BR2_PACKAGE_LINUX_FIRMWARE_RTL_RTW88=y
BR2_PACKAGE_LINUX_FIRMWARE_MEDIATEK_MT7921=y
```
